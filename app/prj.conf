## Kconfig
```
# Assignment
# Define int APP_HEARTBEAT_PERIOD_MS (default 500, range 100-2000)

config APP_HEARTBEAT_PERIOD_MS
    int "Application heartbeat period in milliseconds"
    range 100 2000
    default 500

source "Kconfig.zephyr"
```

## prj.conf
```kconfig
CONFIG_GPIO=y
CONFIG_LOG=y
CONFIG_LED_SUBSYSTEM=y
CONFIG_BLINK_SLEEP_250MS=y
```

## app.overlay
```dts
// Assignment:
// Add an app-led alias pointing to your board's LED0
// In main.cpp, use DT_ALIAS(app_led) for the GPIO and CONFIG_APP_HEARTBEAT_PERIOD_MS for the sleep duration
// Verify: open menuconfig, change the period, rebuild. LED blink speed must change
// Use tag l4-task1

/ {
    aliases {
        app-led = &red_led;
    };
};
```

## src/main.cpp
```c
#include <zephyr/drivers/gpio.h>
#include <zephyr/kernel.h>
#include <zephyr/logging/log.h>

/* The devicetree node identifier for the "app-led" alias. */
#define LED_NODE DT_ALIAS(app_led)

static const struct gpio_dt_spec led = GPIO_DT_SPEC_GET(LED_NODE, gpios);

LOG_MODULE_REGISTER(main, LOG_LEVEL_INF);

int main(void)
{
    bool led_state = true;

    if (!gpio_is_ready_dt(&led)) {
        return 0;
    }

    if (gpio_pin_configure_dt(&led, GPIO_OUTPUT_ACTIVE) < 0) {
        return 0;
    }

    while (1) {
        if (gpio_pin_toggle_dt(&led) < 0) return 0;

        led_state = !led_state;
        LOG_INF("LED state: %s", led_state ? "ON" : "OFF");
        k_msleep(CONFIG_APP_HEARTBEAT_PERIOD_MS);
    }
    return 0;
}
```
